#include "ssd1306.h"
#include "stm32f1xx.h"

/* ── I2C write primitive ────────────────────────────────────── */
static void i2c_write_cmd(uint8_t cmd) {
    while (I2C1->SR2 & I2C_SR2_BUSY);

    I2C1->CR1 |= I2C_CR1_START;
    while (!(I2C1->SR1 & I2C_SR1_SB));

    I2C1->DR = 0x78;  /* addr 0x3C << 1, write */
    while (!(I2C1->SR1 & I2C_SR1_ADDR));
    (void)I2C1->SR2;

    I2C1->DR = 0x00;  /* control byte: command */
    while (!(I2C1->SR1 & I2C_SR1_TXE));

    I2C1->DR = cmd;
    while (!(I2C1->SR1 & I2C_SR1_BTF));

    I2C1->CR1 |= I2C_CR1_STOP;
}

static void i2c_write_data(const uint8_t *data, uint16_t len) {
    while (I2C1->SR2 & I2C_SR2_BUSY);

    I2C1->CR1 |= I2C_CR1_START;
    while (!(I2C1->SR1 & I2C_SR1_SB));

    I2C1->DR = 0x78;
    while (!(I2C1->SR1 & I2C_SR1_ADDR));
    (void)I2C1->SR2;

    I2C1->DR = 0x40;  /* control byte: data */
    while (!(I2C1->SR1 & I2C_SR1_TXE));

    for (uint16_t i = 0; i < len; i++) {
        I2C1->DR = data[i];
        while (!(I2C1->SR1 & I2C_SR1_TXE));
    }

    while (!(I2C1->SR1 & I2C_SR1_BTF));
    I2C1->CR1 |= I2C_CR1_STOP;
}

/* ── Framebuffer ─────────────────────────────────────────────── */
static uint8_t g_fb[SSD1306_WIDTH * SSD1306_PAGES];  /* 128 × 8 = 1024 bytes */

/* ── Initialization sequence ─────────────────────────────────── */
void ssd1306_init(void) {
    static const uint8_t init_cmds[] = {
        0xAE,           /* display off */
        0xD5, 0x80,     /* clock div */
        0xA8, 0x3F,     /* multiplex = 64 */
        0xD3, 0x00,     /* display offset = 0 */
        0x40,           /* start line = 0 */
        0x8D, 0x14,     /* charge pump on */
        0x20, 0x00,     /* horizontal addressing */
        0xA1,           /* segment remap (flip X) */
        0xC8,           /* COM scan direction (flip Y) */
        0xDA, 0x12,     /* COM pins alt */
        0x81, 0xCF,     /* contrast */
        0xD9, 0xF1,     /* pre-charge */
        0xDB, 0x40,     /* VCOMH deselect */
        0xA4,           /* output follows RAM */
        0xA6,           /* normal (non-inverted) */
        0xAF,           /* display on */
    };

    for (uint32_t i = 0; i < sizeof(init_cmds); i++) {
        i2c_write_cmd(init_cmds[i]);
    }

    ssd1306_clear();
    ssd1306_refresh();
}

void ssd1306_clear(void) {
    for (uint16_t i = 0; i < sizeof(g_fb); i++) {
        g_fb[i] = 0x00;
    }
}

/* Flush entire framebuffer to display using horizontal addressing */
void ssd1306_refresh(void) {
    i2c_write_cmd(0x21);  /* column start/end */
    i2c_write_cmd(0x00);
    i2c_write_cmd(127);
    i2c_write_cmd(0x22);  /* page start/end */
    i2c_write_cmd(0x00);
    i2c_write_cmd(7);
    i2c_write_data(g_fb, sizeof(g_fb));
}

void ssd1306_draw_pixel(uint8_t x, uint8_t y, uint8_t color) {
    if (x >= SSD1306_WIDTH || y >= SSD1306_HEIGHT) return;
    uint16_t idx = x + ((uint16_t)(y >> 3) * SSD1306_WIDTH);
    if (color) g_fb[idx] |=  (1U << (y & 7));
    else       g_fb[idx] &= ~(1U << (y & 7));
}

/* ── 5×8 font (ASCII 32–127) ─────────────────────────────────── */
static const uint8_t g_font_5x8[96][5] = {
    {0x00,0x00,0x00,0x00,0x00}, /*   */
    {0x00,0x00,0x5F,0x00,0x00}, /* ! */
    {0x00,0x07,0x00,0x07,0x00}, /* " */
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    {0x08,0x1C,0x2A,0x08,0x08}, /* <-- delete symbol */
};

void ssd1306_draw_char(uint8_t x, uint8_t page, char c) {
    if (page > 7 || c < 32 || c > 127) return;
    const uint8_t *glyph = g_font_5x8[(uint8_t)c - 32];
    for (uint8_t col = 0; col < 5; col++) {
        if (x + col >= SSD1306_WIDTH) break;
        g_fb[x + col + (uint16_t)page * SSD1306_WIDTH] = glyph[col];
    }
    /* 1-pixel inter-char spacing */
    if (x + 5 < SSD1306_WIDTH) {
        g_fb[x + 5 + (uint16_t)page * SSD1306_WIDTH] = 0;
    }
}

/* 2x scaled 5x8 char → 10x16 pixels. y = pixel row (0-63). */
void ssd1306_draw_big_char(uint8_t x, uint8_t y, char c) {
    if (c < 32 || c > 127) return;
    const uint8_t *g = g_font_5x8[(uint8_t)c - 32];
    for (uint8_t col = 0; col < 5; col++) {
        for (uint8_t row = 0; row < 8; row++) {
            if (g[col] & (1 << row)) {
                uint8_t bx = (uint8_t)(x + col * 2);
                uint8_t by = (uint8_t)(y + row * 2);
                ssd1306_draw_pixel(bx,     by,     1);
                ssd1306_draw_pixel(bx + 1, by,     1);
                ssd1306_draw_pixel(bx,     by + 1, 1);
                ssd1306_draw_pixel(bx + 1, by + 1, 1);
            }
        }
    }
}

/* Draw time-colon (two 3x3 dots) at position (x,y), 16 pixels tall */
void ssd1306_draw_big_colon(uint8_t x, uint8_t y) {
    for (uint8_t dx = 0; dx < 3; dx++) {
        for (uint8_t dy = 0; dy < 3; dy++) {
            ssd1306_draw_pixel((uint8_t)(x + dx), (uint8_t)(y + 3 + dy), 1);
            ssd1306_draw_pixel((uint8_t)(x + dx), (uint8_t)(y + 10 + dy), 1);
        }
    }
}

void ssd1306_draw_string(uint8_t x, uint8_t page, const char *s) {
    while (*s && x < SSD1306_WIDTH) {
        ssd1306_draw_char(x, page, *s);
        x += 6;
        s++;
    }
}

/* Bresenham line */
void ssd1306_draw_line(uint8_t x0, uint8_t y0, uint8_t x1, uint8_t y1) {
    int16_t dx = (int16_t)x1 - x0; if (dx < 0) dx = -dx;
    int16_t dy = (int16_t)y1 - y0; if (dy < 0) dy = -dy;
    int16_t sx = (x0 < x1) ? 1 : -1;
    int16_t sy = (y0 < y1) ? 1 : -1;
    int16_t err = dx - dy;
    int16_t x = x0, y = y0;

    while (1) {
        ssd1306_draw_pixel((uint8_t)x, (uint8_t)y, 1);
        if (x == x1 && y == y1) break;
        int16_t e2 = 2 * err;
        if (e2 > -dy) { err -= dy; x += sx; }
        if (e2 <  dx) { err += dx; y += sy; }
    }
}
